/* Copyright (c) 2018, The Linux Foundation. All rights reserved.
 *
 * This program is free software; you can redistribute it and/or modify
 * it under the terms of the GNU General Public License version 2 and
 * only version 2 as published by the Free Software Foundation.
 *
 * This program is distributed in the hope that it will be useful,
 * but WITHOUT ANY WARRANTY; without even the implied warranty of
 * MERCHANTABILITY or FITNESS FOR A PARTICULAR PURPOSE.  See the
 * GNU General Public License for more details.
 */

/dts-v1/;
/plugin/;

#include <dt-bindings/clock/qcom,gcc-sm8150.h>
#include <dt-bindings/clock/qcom,camcc-sm8150.h>
#include <dt-bindings/clock/qcom,rpmh.h>
#include <dt-bindings/interrupt-controller/arm-gic.h>

#include "../qcom/sm8150-mtp.dtsi"
#include "../qcom/sm8150-mtp-audio-overlay.dtsi" /* HTC_AUD */

#include "../qcom/sdx5xm-external-soc.dtsi"
#include "../qcom/sm8150-sdx50m.dtsi"

#include "sm8150-htc-common.dtsi"
#include "sm8150-htc_rtx.dtsi"
#include "sm8150-htc_rtx-batt-common.dtsi"
#include "sm8150-htc_rtx-usb.dtsi"
#include "sm8150-audio-rt5-xa.dtsi"    /* HTC_AUD */
#include "sm8150-htc_rt5-sensor.dtsi"
#include "sm8150-htc_rtx-key.dtsi"
#include "sm8150-htc_rt5-xa-nc-pins.dtsi"
#include "sm8150-htc_rt5-xa_touch.dtsi"
#include "sm8150-htc_rt5-fan.dtsi" /* HTC FAN */

/ {
	model = "overlay HTC RTX XA";
	compatible = "qcom,sm8150-mtp", "qcom,sm8150", "qcom,mtp";
	qcom,msm-id = <485 0x10000>, <486 0x10000>, <487 0x10000>, <492 0x10000>;
	qcom,board-id = <0x0 0x0>;
};
