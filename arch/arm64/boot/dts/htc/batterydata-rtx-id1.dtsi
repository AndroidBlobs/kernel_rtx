htc,rtx-id1-batterydata {
	qcom,fastchg-current-ma = <3800>;
	qcom,battery-type = "rtx_id1";
	htc,batt_id = <1>;
	htc,id_raw_min = <0>;
	htc,id_raw_max = <47000>;

	/* setting below from QCOM except of qcom,battery-type is renamed as above */
	qcom,profile-revision = <24>;
	/* #3821088_HTC_B2Q6U100_7660mAh_averaged_MasterSlave_Jan22nd2019*/
	qcom,max-voltage-uv = <4400000>;
	qcom,fg-cc-cv-threshold-mv = <4390>;
	qcom,nom-batt-capacity-mah = <7660>;
	qcom,batt-id-kohm = <10>;
	qcom,battery-beta = <4250>;
	qcom,therm-room-temp = <100000>;
	qcom,therm-coefficients = <0x2318 0xd0c 0xdaf7 0xc556 0x848d>;
	qcom,therm-center-offset = <0x70>;
	qcom,therm-pull-up = <100>;
	qcom,rslow-normal-coeffs = <0x1a 0x02 0x6f 0x13>;
	qcom,rslow-low-coeffs = <0x8a 0xf4 0x2f 0x13>;
	qcom,checksum = <0x6814>;
	qcom,gui-version = "PM855GUI - 1.0.0.13";
	qcom,fg-profile-data = [
		 09 00 21 E3
		 CD CC FA D2
		 DB CC 00 00
		 F3 B4 A4 82
		 FE 87 D6 9C
		 04 80 68 80
		 13 00 1A 02
		 6F 13 D1 06
		 13 EB CE 07
		 32 00 01 EB
		 E3 ED 35 CB
		 D3 0A D5 ED
		 68 C5 55 1B
		 66 03 01 CA
		 60 00 55 00
		 49 00 43 00
		 33 00 30 00
		 35 00 3D 00
		 42 00 44 00
		 3E 00 60 00
		 30 00 3D 00
		 45 00 3F 00
		 34 00 7B 00
		 5A 64 48 00
		 3B 00 34 08
		 60 F8 44 00
		 43 00 57 10
		 4C 10 3B 00
		 84 28 5C 50
		 4C 68 3D 0A
		 3B 00 D8 00
		 32 20 EF 0C
		 B8 FA 9F 04
		 5D 1C 88 03
		 92 0D 7B 22
		 72 17 EC 42
		 DA 5D 2E 02
		 6F 11 7A 1F
		 D4 05 2F 02
		 51 FD F6 1C
		 B5 01 64 04
		 10 02 E3 17
		 B1 23 9E 44
		 1F 5A 7C 11
		 2E 1F 28 E6
		 F3 C3 9B C5
		 E6 1C 7D C9
		 77 05 03 B3
		 8A 17 E1 8B
		 6E 84 3D 8A
		 83 98 09 80
		 1D D3 E4 0D
		 9D FC A9 F2
		 00 F8 89 DC
		 2B E2 F9 07
		 B1 D2 69 B4
		 67 10 0E F8
		 B8 D3 BB 02
		 15 05 D9 03
		 CE 07 32 00
		 BD 02 2B 03
		 C6 05 71 02
		 38 05 99 03
		 51 02 03 02
		 02 05 47 00
		 38 00 3F 00
		 42 64 46 00
		 46 F8 47 00
		 47 E8 45 00
		 47 00 51 08
		 3B 08 3A 00
		 49 20 4A 40
		 59 58 6B 0E
		 44 00 57 00
		 56 08 59 F8
		 59 00 3E 00
		 42 10 4E 10
		 4B 00 5E 28
		 72 48 43 58
		 55 0D 5A 00
		 58 F8 38 08
		 D8 00 32 1F
		 91 05 72 0A
		 95 0C F0 1C
		 E0 22 48 44
		 C4 5B A2 18
		 BF 03 0A 04
		 E6 02 6A 0F
		 3F 0A DD 1F
		 82 05 75 02
		 AB 04 BD 1C
		 23 03 D8 05
		 4C 02 7C 18
		 10 02 91 05
		 F9 03 6A 00
		 47 1F 17 04
		 2C 02 87 06
		 C2 1C AC 02
		 82 04 E4 03
		 9C 18 62 03
		 A9 04 4A 02
		 68 00 1F 01
		 C0 00 FA 00
		 F4 1D 00 00
	];
};
