&mdss_mdp {
	dsi_ft8607_video: qcom,mdss_dsi_ft8607_video {
		qcom,mdss-dsi-panel-name = "ft8607 hd video mode panel";
		qcom,mdss-dsi-panel-type = "dsi_video_mode";
		qcom,mdss-dsi-virtual-channel-id = <0>;
		qcom,mdss-dsi-stream = <0>;
		qcom,mdss-dsi-h-left-border = <0>;
		qcom,mdss-dsi-h-right-border = <0>;
		qcom,mdss-dsi-v-top-border = <0>;
		qcom,mdss-dsi-v-bottom-border = <0>;
		qcom,mdss-dsi-bpp = <24>;
		qcom,mdss-dsi-color-order = "rgb_swap_rgb";
		qcom,mdss-dsi-underflow-color = <0xff>;
		qcom,mdss-dsi-border-color = <0>;
		qcom,mdss-dsi-h-sync-pulse = <0>;
		qcom,mdss-dsi-traffic-mode = "non_burst_sync_event";
		qcom,mdss-dsi-bllp-eof-power-mode;
		qcom,mdss-dsi-bllp-power-mode;
		qcom,mdss-dsi-lane-0-state;
		qcom,mdss-dsi-lane-1-state;
		qcom,mdss-dsi-lane-2-state;
		qcom,mdss-dsi-lane-3-state;
		qcom,mdss-dsi-dma-trigger = "trigger_sw";
		qcom,mdss-dsi-mdp-trigger = "none";
		qcom,mdss-dsi-lp11-init;
		qcom,mdss-dsi-reset-sequence = <1 1>, <0 1>, <1 20>;
		qcom,mdss-pan-physical-width-dimension = <61>;
		qcom,mdss-pan-physical-height-dimension = <110>;

		qcom,mdss-dsi-display-timings {
			timing@0 {
				qcom,mdss-dsi-panel-width = <720>;
				qcom,mdss-dsi-panel-height = <1280>;
				qcom,mdss-dsi-h-front-porch = <76>;
				qcom,mdss-dsi-h-back-porch = <52>;
				qcom,mdss-dsi-h-pulse-width = <20>;
				qcom,mdss-dsi-h-sync-skew = <0>;
				qcom,mdss-dsi-v-back-porch = <22>;
				qcom,mdss-dsi-v-front-porch = <40>;
				qcom,mdss-dsi-v-pulse-width = <3>;
				qcom,mdss-dsi-panel-framerate = <60>;
				qcom,mdss-dsi-on-command = [
					// Page 1
					39 01 00 00 00 00 06 F0 46 23 11 01 01
					39 01 00 00 00 00 02 B1 15
					39 01 00 00 00 00 02 B2 15
					39 01 00 00 00 00 11 B3 05 00 00 00 00 00 00 00 0C 00 00 00 00 00 00 00
					39 01 00 00 00 00 11 B4 0F 00 00 00 00 00 00 00 08 00 00 00 00 00 00 00
					39 01 00 00 00 00 03 B5 00 00
					39 01 00 00 00 00 05 B7 44 00 00 00
					39 01 00 00 00 00 05 B8 54 00 00 00
					39 01 00 00 00 00 02 B9 00
					39 01 00 00 00 00 0B CB 00 00 00 00 0C 08 CC 20 20 00
					39 01 00 00 00 00 3D D1 00 00 00 10 00 38 00 48 00 5A 00 73 00 85 00 95 00 A2 00 D4 00 F9 01 30 01 5C 01 A1 01 DB 01 DD 02 1A 02 64 02 93 02 D1 02 F8 03 2B 03 3A 03 4A 03 5A 03 6D 03 81 03 9A 03 B3 03 C2
					39 01 00 00 00 00 3D D2 00 00 00 10 00 38 00 48 00 5A 00 73 00 85 00 95 00 A2 00 D4 00 F9 01 30 01 5C 01 A1 01 DB 01 DD 02 1A 02 64 02 93 02 D1 02 F8 03 2B 03 3A 03 4A 03 5A 03 6D 03 81 03 9A 03 B3 03 C2
					39 01 00 00 00 00 3D D3 00 00 00 10 00 38 00 48 00 5A 00 73 00 85 00 95 00 A2 00 D4 00 F9 01 30 01 5C 01 A1 01 DB 01 DD 02 1A 02 64 02 93 02 D1 02 F8 03 2B 03 3A 03 4A 03 5A 03 6D 03 81 03 9A 03 B3 03 C2
					39 01 00 00 00 00 3D D4 00 00 00 10 00 38 00 48 00 5A 00 73 00 85 00 95 00 A2 00 D4 00 F9 01 30 01 5C 01 A1 01 DB 01 DD 02 1A 02 64 02 93 02 D1 02 F8 03 2B 03 3A 03 4A 03 5A 03 6D 03 81 03 9A 03 B3 03 C2
					39 01 00 00 00 00 3D D5 00 00 00 10 00 38 00 48 00 5A 00 73 00 85 00 95 00 A2 00 D4 00 F9 01 30 01 5C 01 A1 01 DB 01 DD 02 1A 02 64 02 93 02 D1 02 F8 03 2B 03 3A 03 4A 03 5A 03 6D 03 81 03 9A 03 B3 03 C2
					39 01 00 00 00 00 3D D6 00 00 00 10 00 38 00 48 00 5A 00 73 00 85 00 95 00 A2 00 D4 00 F9 01 30 01 5C 01 A1 01 DB 01 DD 02 1A 02 64 02 93 02 D1 02 F8 03 2B 03 3A 03 4A 03 5A 03 6D 03 81 03 9A 03 B3 03 C2
					// Page 0
					39 01 00 00 00 00 06 F0 46 23 11 01 00
					39 01 00 00 00 00 08 B2 01 9B 31 42 07 FF 06
					39 01 00 00 00 00 02 B3 E9
					39 01 00 00 00 00 05 BA 0F 90 30 59
					39 01 00 00 00 00 05 BB 05 69 09 02
					39 01 00 00 00 00 03 BC 00 80
					39 01 00 00 00 00 07 BD C6 00 00 20 00 30
					39 01 00 00 00 00 05 BE 01 04 0F FF
					39 01 00 00 00 00 02 BF 0A
					39 01 00 00 00 00 03 C0 02 80
					39 01 00 00 00 00 03 C1 10 00
					39 01 00 00 00 00 03 C2 18 07
					39 01 00 00 00 00 05 C3 00 18 18 18
					39 01 00 00 00 00 05 C5 01 01 C0 00
					39 01 00 00 00 00 05 C7 3D FA 08 55
					39 01 00 00 00 00 48 C9 09 01 2A 02 04 08 00 09 40 04 02 00 07 01 90 E0 01 03 03 03 01 08 01 90 E0 00 04 02 00 01 08 11 80 20 01 01 01 01 01 08 11 80 20 00 02 E4 EA E4 E4 E4 E4 3F CC CC CC 8A CC 00 55 00 00 00 00 00 02 15 16 02 16 16 16
					39 01 00 00 00 00 12 CA 00 00 00 00 00 00 00 00 00 00 00 00 00 00 00 00 00
					39 01 00 00 00 00 2F CB 00 02 00 11 80 20 66 00 02 11 80 80 66 00 02 11 80 80 06 05 03 00 05 05 00 04 00 00 00 00 00 00 00 00 01 01 01 66 01 03 66 01 03 00 12 0F
					39 01 00 00 00 00 19 CC 30 01 81 00 00 11 80 20 01 03 00 20 00 00 00 00 00 00 80 01 00 02 00 00
					39 01 00 00 00 00 16 CD 12 10 00 00 00 00 10 10 08 08 31 00 00 10 12 10 81 40 00 00 01
					39 01 00 00 00 00 44 CE 54 55 58 59 00 00 00 00 08 08 04 05 06 07 6E 6F 6A 6B 6C 6D 68 69 08 08 00 00 00 00 00 00 00 00 00 00 00 00 50 51 00 00 00 00 00 00 00 00 00 00 00 00 00 00 00 00 00 00 00 00 00 00 00 00 00 00 00 00 00
					39 01 00 00 00 00 02 EE 71
					39 01 00 00 00 00 0A EF 00 51 2C 74 02 18 84 84 70

					// Page 0: CABC
					39 01 00 00 00 00 02 53 2C
					39 01 00 00 00 00 06 F0 46 23 11 01 00
					39 01 00 00 00 00 02 D0 20
					39 01 00 00 00 00 02 D1 FF
					39 01 00 00 00 00 02 D2 F7
					39 01 00 00 00 00 07 D3 20 11 80 20 8F 01
					39 01 00 00 00 00 02 5E B2
					39 01 00 00 00 00 63 D7 03 B7 03 B7 03 B7 03 B7 03 B7 03 B7 03 B7 03 B7 03 B7 03 B7 03 B7 03 B7 03 B7 03 C0 03 C1 03 C2 03 BC 03 BC 03 BD 03 BE 03 BF 03 C0 03 C0 03 C0 03 C0 03 C3 03 C9 03 CA 03 CC 03 CE 03 D1 03 D4 03 D6 03 D8 03 DB 03 DE 03 E1 03 E6 03 E8 03 E9 03 ED 03 EF 03 F1 03 F4 03 F6 03 F8 03 FB 03 FB 04 00
					39 01 00 00 00 00 03 DF 00 09

					// Page 1
					39 01 00 00 00 00 06 F0 46 23 11 01 01
					39 01 00 00 00 00 02 CA 20
					39 01 00 00 00 00 05 CB 9F C0 C7 EC
					39 01 00 00 00 00 06 FA 00 00 64 00 00
					39 01 00 00 00 00 02 BC 01

					39 01 00 00 00 00 02 35 01
					39 01 00 00 00 00 03 44 00 00

					// Sleep Out
					05 01 00 00 A0 00 01 11

					// Page 1: Gamma Regulator
					39 01 00 00 00 00 04 C3 00 A0 00
					39 01 00 00 00 00 04 C4 00 A0 00

					// DispOn
					05 01 00 00 05 00 01 29
				];
				qcom,mdss-dsi-off-command = [
					05 01 00 00 05 00 02 28 00
					05 01 00 00 09 00 02 10 00
				];
				qcom,mdss-dsi-on-command-state = "dsi_lp_mode";
				qcom,mdss-dsi-off-command-state = "dsi_hs_mode";
			};
		};
	};
};
