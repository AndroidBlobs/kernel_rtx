## drivers/i2c/sensors/Kconfig
```kconfig
#
# Miscellaneous I2C sensor drivers configuration
#

menu "Miscellaneous I2C Chip support"

config SENSORS_ONLY_BMA255
        tristate "BMA255 acceleration sensor support"
        depends on I2C=y
        help
          BMA255 ONLY G-sensor Driver implemented by HTC.

config BOSCH_BMA250_ENABLE_INT1
	tristate "BMA250 acceleration sensor interrupt INT1 support"
	depends on BOSCH_BMA250=y
        help
	  If you say yes here you get INT1 support for Bosch Sensortec's
	  acceleration sensors BMA250.

config BOSCH_BMA250_ENABLE_INT2
	tristate "BMA250 acceleration sensor interrupt INT2 support"
	depends on BOSCH_BMA250=y
	help
	  If you say yes here you get INT2 support for Bosch Sensortec's
	  acceleration sensors BMA250.

config SENSORS_BMA250
	tristate "BMA250 acceleration sensor support"
	depends on I2C=y
	help
	  BMA250 G-sensor Driver implemented by HTC.

config CIR_ALWAYS_READY
        bool "BMA250 CIR Always Ready"
	default n
	help
	  Enable CIR Always Ready

endmenu
```

## drivers/input/touchscreen/focaltech_htc/Kconfig
```kconfig
#
# Focaltech Touchscreen driver configuration
#

config TOUCHSCREEN_FTS
        bool "Focaltech Touchscreen"
                depends on I2C
                default y
                help
                  Say Y here if you have Focaltech touch panel.
                  If unsure, say N.

config TOUCHSCREEN_FTS_DIRECTORY
    string "Focaltech ts directory name"
    default "focaltech_touch"
    depends on TOUCHSCREEN_FTS

config TOUCHSCREEN_ROTATE_FTS_90_DEGREE
        bool "When LCM be landscape, touch reports point should follow display to rotate 90 degree"
        default n
        help
          Say Y here to enable LCM rotate 90 degree.
```

## drivers/usb/fsa3030/Kconfig
```kconfig
#
# USB Switch FSA3030 driver configuration
#
config USB_SWITCH_FSA3030
    bool "USB_SWITCH_FSA3030"
    default n
```

## sound/soc/codecs/tas2557s/Kconfig
```kconfig
config SND_SOC_TAS2557_STEREO
	tristate
	default y
config TAS2557_REGMAP_STEREO
	tristate
	default y
config TAS2557_CODEC_STEREO
	tristate
	default y
config TAS2557_MISC_STEREO
	tristate
	default y
```
